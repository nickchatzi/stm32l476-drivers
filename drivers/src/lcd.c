#include "lcd.h"

uint8_t current_page = 0;
uint8_t current_column = 0;


void LCD_Select() {
    GPIO_WriteToOutputPin(GPIOB, GPIO_PIN_NO_12, GPIO_PIN_RESET);  // Active low
}

void LCD_Unselect() {
    GPIO_WriteToOutputPin(GPIOB, GPIO_PIN_NO_12, GPIO_PIN_SET);
}

void lcd_reset(void)
{
  GPIO_WriteToOutputPin(GPIOA, GPIO_PIN_NO_8, GPIO_PIN_RESET); // RST low
  delay();
  GPIO_WriteToOutputPin(GPIOA, GPIO_PIN_NO_8, GPIO_PIN_SET);   // RST high
  delay();
}

void lcd_send_command(uint8_t cmd) {
    LCD_Select();
    GPIO_WriteToOutputPin(GPIOA, GPIO_PIN_NO_9, GPIO_PIN_RESET);  // RS = 0 for command
    SPI_SendData(SPI2, &cmd, 1);
    while (SPI_GetFlagStatus(SPI2, SPI_FLAG_BUSY));
    LCD_Unselect();
}

void lcd_send_data(uint8_t data) {
    LCD_Select();
    GPIO_WriteToOutputPin(GPIOA, GPIO_PIN_NO_9, GPIO_PIN_SET);  // RS = 1 for data
    SPI_SendData(SPI2, &data, 1);
    while (SPI_GetFlagStatus(SPI2, SPI_FLAG_BUSY));
    LCD_Unselect();
}

void lcd_init() {
    GPIO_WriteToOutputPin(GPIOA, GPIO_PIN_NO_8, GPIO_PIN_RESET);
    delay();
    GPIO_WriteToOutputPin(GPIOA, GPIO_PIN_NO_8, GPIO_PIN_SET);
    delay();

    lcd_send_command(0xE2); // Software reset
    lcd_send_command(0xA2); // Bias 1/9
    lcd_send_command(0xA0); // ADC normal
    lcd_send_command(0xC8); // Common output: reverse
    lcd_send_command(0x23); // Regulator Resistor Select
    lcd_send_command(0x2F); // Power control: Booster, Regulator, Follower
    lcd_send_command(0x4f); //Dynamic contrast
    lcd_send_command(0x40); // Set start line = 0
    lcd_send_command(0x25); 
    lcd_send_command(0x19); 
    lcd_send_command(0xAF); // Display ON

}
void lcd_set_page(uint8_t page)
{
  lcd_send_command(0xB0 | (page & 0x0F));
}

void lcd_set_column(uint8_t column)
{
  lcd_send_command(0x10 | (column >> 4));      // MSB
  lcd_send_command(0x00 | (column & 0x0F));    // LSB
}

void lcd_write_char(char c)
{
  if (c < 32 || c > 126) c = ' '; // sanitize
  const uint8_t *char_data = font5x8[c - 32];
  for (int i = 0; i < 5; i++) {
    lcd_send_data(char_data[i]);
  }
  lcd_send_data(0x00); // space between chars
}

void lcd_write_char_big2x(char c) {
    if (c < 32 || c > 126) c = ' ';  // sanitize
    const uint8_t *char_data = font5x8[c - 32];

    // Top half (page)
    lcd_set_page(current_page);
    lcd_set_column(current_column);
    for (int i = 0; i < 5; i++) {
        uint8_t col = char_data[i];
        uint8_t top_byte = 0;
        for (int b = 0; b < 8; b++) {
            if (col & (1 << b)) {
                top_byte |= (3 << (b * 2));  // duplicate vertically
            }
        }
        // Write each column twice for 2x width
        lcd_send_data(top_byte);
        lcd_send_data(top_byte);
    }
    // spacing
    lcd_send_data(0x00);
    lcd_send_data(0x00);

    // Bottom half (next page)
    lcd_set_page(current_page + 1);
    lcd_set_column(current_column);
    for (int i = 0; i < 5; i++) {
        uint8_t col = char_data[i];
        uint8_t bottom_byte = 0;
        for (int b = 0; b < 8; b++) {
            if (col & (1 << b)) {
                bottom_byte |= (3 << ((b * 2) - 8));  // shift to lower byte for bottom
            }
        }
        // Write each column twice for 2x width
        lcd_send_data(bottom_byte);
        lcd_send_data(bottom_byte);
    }
    // spacing
    lcd_send_data(0x00);
    lcd_send_data(0x00);

    // advance cursor
    current_column += 12;
}

void lcd_write_char_big3x(char c)
{
    if (c < 32 || c > 126) c = ' ';
    const uint8_t *char_data = font5x8[c - 32];

    // Temporary buffer for scaled character: 3 pages (24 rows) x 15 columns
    uint8_t scaled_char[3][15] = {0};

    for (int col = 0; col < 5; col++) {
        for (int row = 0; row < 8; row++) {
            uint8_t pixel = (char_data[col] >> row) & 0x01;

            // Set 3x3 block in scaled_char
            for (int dy = 0; dy < 3; dy++) {
                for (int dx = 0; dx < 3; dx++) {
                    if (pixel) {
                        int x = col * 3 + dx;
                        int y = row * 3 + dy;
                        int page = y / 8;
                        int bit = y % 8;
                        scaled_char[page][x] |= (1 << bit);
                    }
                }
            }
        }
    }

    // Write scaled_char to screen: 3 pages tall
    for (int page = 0; page < 3; page++) {
        lcd_set_page(current_page + page);  // You must set current_page correctly before this call
        lcd_set_column(current_column);     // Set your X coordinate here
        for (int i = 0; i < 15; i++) {
            lcd_send_data(scaled_char[page][i]);
        }
    }

    current_column += 15; // Move to next character column
}


void lcd_set_cursor(uint8_t page, uint8_t column) {
    current_page = page;
    current_column = column;
}

void lcd_set_black_background(void)
{
  for (int page = 0; page < 8; page++) {
      lcd_set_page(page);
      lcd_set_column(0);
      for (int col = 0; col < 128; col++) {
          lcd_send_data(0x00);  // black background
      }
  }
}

const uint8_t font5x8[][5] = {
  // ASCII 32–47
  {0x00,0x00,0x00,0x00,0x00}, // ' '
  {0x00,0x00,0x5F,0x00,0x00}, // '!'
  {0x00,0x07,0x00,0x07,0x00}, // '"'
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  {0x20,0x10,0x08,0x04,0x02}, // '/'

  // ASCII 48–63
  {0x3E,0x51,0x49,0x45,0x3E}, // '0'
  {0x00,0x42,0x7F,0x40,0x00}, // '1'
  {0x42,0x61,0x51,0x49,0x46}, // '2'
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  {0x02,0x01,0x51,0x09,0x06}, // '?'

  // ASCII 64–79
  {0x32,0x49,0x79,0x41,0x3E}, // '@'
  {0x7E,0x11,0x11,0x11,0x7E}, // 'A'
  {0x7F,0x49,0x49,0x49,0x36}, // 'B'
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  {0x3E,0x41,0x41,0x41,0x3E}, // 'O'

  // ASCII 80–95
  {0x7F,0x09,0x09,0x09,0x06}, // 'P'
  {0x3E,0x41,0x51,0x21,0x5E}, // 'Q'
  {0x7F,0x09,0x19,0x29,0x46}, // 'R'
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  {0x40,0x40,0x40,0x40,0x40}, // '_'

  // ASCII 96–111
  {0x00,0x01,0x02,0x04,0x00}, // '`'
  {0x20,0x54,0x54,0x54,0x78}, // 'a'
  {0x7F,0x48,0x44,0x44,0x38}, // 'b'
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  {0x38,0x44,0x44,0x44,0x38}, // 'o'

  // ASCII 112–127
  {0x7C,0x14,0x14,0x14,0x08}, // 'p'
  {0x08,0x14,0x14,0x18,0x7C}, // 'q'
  {0x7C,0x08,0x04,0x04,0x08}, // 'r'
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  {0x10,0x08,0x08,0x10,0x08}, // '~'
};